/*
  Created by Fabrizio Di Vittorio (fdivitto2013@gmail.com) - <http://www.fabgl.com>
  Copyright (c) 2019-2021 Fabrizio Di Vittorio.
  All rights reserved.

  This library and related software is available under GPL v3 or commercial license. It is always free for students, hobbyists, professors and researchers.
  It is not-free if embedded as firmware in commercial boards.


* Contact for commercial license: fdivitto2013@gmail.com


* GPL license version 3, for non-commercial use:

  FabGL is free software: you can redistribute it and/or modify
  it under the terms of the GNU General Public License as published by
  the Free Software Foundation, either version 3 of the License, or
  (at your option) any later version.

  FabGL is distributed in the hope that it will be useful,
  but WITHOUT ANY WARRANTY; without even the implied warranty of
  MERCHANTABILITY or FITNESS FOR A PARTICULAR PURPOSE.  See the
  GNU General Public License for more details.

  You should have received a copy of the GNU General Public License
  along with FabGL.  If not, see <http://www.gnu.org/licenses/>.
 */


/*
 * TFT Display signals:
 *   SCK  => GPIO 18
 *   MOSI => GPIO 23
 *   D/C  => GPIO 22
 *   RESX => GPIO 21
 */



#include "fabgl.h"

#include <math.h>



#define TFT_SCK    18
#define TFT_MOSI   23
#define TFT_DC     22
#define TFT_RESET  21
#define TFT_SPIBUS VSPI_HOST



fabgl::ST7789Controller DisplayController;



// Mask, 1 bit per pixel. One byte contains 8 pixels. 0 = transparent, 1 = foreground color (in this case it is "RGB888(255, 255, 0)".
const uint8_t pacman_data[] = {
  0x00, 0x00, 0x1e, 0x00, 0x00,
  0x00, 0x03, 0xff, 0xe0, 0x00,
  0x00, 0x0f, 0xff, 0xfc, 0x00,
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  0x00, 0x00, 0x3f, 0x00, 0x00,
};
Bitmap pacman = Bitmap(40, 43, &pacman_data[0], PixelFormat::Mask, RGB888(255, 255, 0));

// ABGR, 2 bits per channel. One byte contains one pixel.
const uint8_t pacenemy_data[] = {
  0x00, 0x00, 0x00, 0x00, 0x00, 0x00, 0x00, 0x00, 0x00, 0x00, 0x00, 0x00,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 0x00,
  0x00, 0x00, 0x00, 0x00, 0x00, 0x00, 0x00, 0x00, 0x00, 0x00, 0x00, 0x00,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 0x00,
  0x00, 0x00, 0x00, 0x00, 0x00, 0x00, 0x00, 0x00, 0x00, 0x00, 0x00, 0x00,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 0x00,
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  0x00, 0x00, 0x00, 0x00, 0x00, 0x00, 0x00, 0x00, 0x00, 0x00, 0x00, 0x00,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 0x00,
};
Bitmap pacenemy = Bitmap(42, 42, &pacenemy_data[0], PixelFormat::RGBA2222);



// RGBA, 8 bits per channel. Four bytes contains one pixel.
const uint8_t alien_data[] = {
  0x00, 0x00, 0x00, 0x00, 0x00, 0x00, 0x00, 0x00, 0x00, 0x00, 0x00, 0x00,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 0x00,
  0x00, 0x00, 0x00, 0x00, 0x00, 0x00, 0x00, 0x00, 0x00, 0x00, 0x00, 0x00,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 0x00,
  0x00, 0x00, 0x00, 0x00, 0x00, 0x00, 0x00, 0x00, 0x00, 0x00, 0x00, 0x00,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 0x00,
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  0x00, 0x00, 0x00, 0x00, 0x00, 0x00, 0x00, 0x00, 0x00, 0x00, 0x00, 0x00,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 0x00,
};
Bitmap alien = Bitmap(50, 41, &alien_data[0], PixelFormat::RGBA8888);



Sprite sprites[3];



void setup()
{
  //Serial.begin(115200); delay(500); Serial.write("\n\n\n"); // DEBUG ONLY

  DisplayController.begin(TFT_SCK, TFT_MOSI, TFT_DC, TFT_RESET, -1, TFT_SPIBUS);
  DisplayController.setResolution(TFT_240x240);

  // draw background
  Canvas cv(&DisplayController);
  cv.setBrushColor(RGB888(255, 128, 0));
  cv.clear();
  cv.setPenColor(RGB888(64, 64, 0));
  for (int i = 0; i < cv.getWidth(); i += 10)
    cv.drawLine(i, 0, i, cv.getHeight() - 1);
  for (int i = 0; i < cv.getHeight(); i += 10)
    cv.drawLine(0, i, cv.getWidth() - 1, i);

  // associates bitmaps to sprites
  sprites[0].addBitmap(&pacman);
  sprites[1].addBitmap(&pacenemy);
  sprites[2].addBitmap(&alien);

  // sets initial position
  sprites[0].moveTo(0, 50);
  sprites[1].moveTo(0, 100);
  sprites[2].moveTo(0, 150);

  // makes sprites visible
  sprites[0].visible = true;
  sprites[1].visible = true;
  sprites[2].visible = true;

  // add sprites to display controller
  DisplayController.setSprites(sprites, 3);
}



void loop()
{
  static double count = 0;

  // set position of sprite 0
  sprites[0].x += 1;
  if (sprites[0].x >= DisplayController.getViewPortWidth())
    sprites[0].x = -sprites[0].getWidth();
  sprites[0].y = 50 + 35.0 * sin(count);

  // set position of sprite 1
  sprites[1].x += 1;
  if (sprites[1].x >= DisplayController.getViewPortWidth())
    sprites[1].x = -sprites[1].getWidth();
  sprites[1].y = 100 + 35.0 * cos(count);

  // set position of sprite 2
  sprites[2].x += 1;
  if (sprites[2].x >= DisplayController.getViewPortWidth())
    sprites[2].x = -sprites[2].getWidth();
  sprites[2].y = 150 + 35.0 * sin(count);

  // update sprites positions
  DisplayController.refreshSprites();

  count += 0.10;

  delay(max(10, 50 - (int)count / 2));
}






